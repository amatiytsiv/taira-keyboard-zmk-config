## config/boards/shields/taira/Kconfig.shield
```kconfig
# Copyright (c) 2020 The ZMK Contributors
# SPDX-License-Identifier: MIT

config SHIELD_amaKB_LEFT
	def_bool $(shields_list_contains,amaKB_left)

config SHIELD_amaKB_RIGHT
	def_bool $(shields_list_contains,amaKB_right)
```
